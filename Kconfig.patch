## Kconfig.patch
```kconfig
--- /home/stephan/dd-wrt/src/linux/universal/linux-4.4/drivers/net/wireless/Kconfig	2021-03-31 23:13:07.850000000 +0200
+++ Kconfig	2021-03-05 19:27:20.773260400 +0100
@@ -284,16 +284,16 @@
 source "drivers/net/wireless/zd1211rw/Kconfig"
 source "drivers/net/wireless/mwifiex/Kconfig"
 source "drivers/net/wireless/cw1200/Kconfig"
-if RALINK_DEVICE
-source "drivers/net/wireless/rt3352/rt2860v2_ap/Kconfig"
-source "drivers/net/wireless/rt3352/rt2860v2_sta/Kconfig"
-endif
-if SOC_MT7620_OPENWRT
-source "drivers/net/wireless/rt7620/rt2860v2_ap/Kconfig"
-source "drivers/net/wireless/rt7620/rt2860v2_sta/Kconfig"
-source "drivers/net/wireless/rt5592/Kconfig"
-source "drivers/net/wireless/rt7612/rlt_wifi/Kconfig"
-endif
+#if RALINK_DEVICE
+#source "drivers/net/wireless/rt3352/rt2860v2_ap/Kconfig"
+#source "drivers/net/wireless/rt3352/rt2860v2_sta/Kconfig"
+#endif
+#if SOC_MT7620_OPENWRT
+#source "drivers/net/wireless/rt7620/rt2860v2_ap/Kconfig"
+#source "drivers/net/wireless/rt7620/rt2860v2_sta/Kconfig"
+#source "drivers/net/wireless/rt5592/Kconfig"
+#source "drivers/net/wireless/rt7612/rlt_wifi/Kconfig"
+#endif
 source "drivers/net/wireless/rsi/Kconfig"
 
 endif # WLAN
```
